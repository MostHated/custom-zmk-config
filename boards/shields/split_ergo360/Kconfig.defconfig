## boards/shields/split_ergo360/Kconfig.defconfig
```kconfig
if SHIELD_SPLIT_ERGO360_LEFT

config ZMK_KEYBOARD_NAME
    default "split_ergo360"

config ZMK_SPLIT_ROLE_CENTRAL
    default y
    
config ZMK_DISPLAY
    default y
    
endif # SHIELD_SPLIT_ERGO360_LEFT

if SHIELD_SPLIT_ERGO360_LEFT || SHIELD_SPLIT_ERGO360_RIGHT

config ZMK_SPLIT
    default y

endif # SHIELD_SPLIT_ERGO360_LEFT || SHIELD_SPLIT_ERGO360_RIGHT
```

## boards/shields/split_ergo360/Kconfig.shield
```kconfig
config SHIELD_SPLIT_ERGO360_LEFT
    def_bool $(shields_list_contains,split_ergo360_left)

config SHIELD_SPLIT_ERGO360_RIGHT
    def_bool $(shields_list_contains,split_ergo360_right)
```
